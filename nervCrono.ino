#define __DEBUG__

#include <SPI.h>
#include <Wire.h>
#include <Adafruit_GFX.h>
#include <Adafruit_SSD1306.h>

// Definir constantes
#define ANCHO_PANTALLA 128 // ancho pantalla OLED
#define ALTO_PANTALLA 64 // alto pantalla OLED

// Objeto de la clase Adafruit_SSD1306
Adafruit_SSD1306 display(ANCHO_PANTALLA, ALTO_PANTALLA, &Wire, -1);


// Temporizador
unsigned long marcaTiempoDate = 0;
unsigned long tiempoRefreshDate = 1000;
 
// Variables almacena tiempo millis
int dias;
int horas;
int minutos;
int segundos;

int pulsos;
 
// Cadena para almacenar texto formateado
char cadenaTiempo[16];
 
/*
  Función que convierte millis() a segundos, minutos, horas y días
  Almacena la información en variables globales
*/
void millisToTiempo(unsigned long valMillis) {
  // Se obtienen los segundos
  valMillis = valMillis / 1000;
 
  segundos = valMillis % 60; // se divide entre segundos por minuto y te quedas con el resto
  minutos = valMillis / 60; // Se convierte a minutos
  minutos = minutos % 60; // se divide entre minutos por hora y te quedas con el resto
  horas = (valMillis / 60) / 60; // Se convierte en horas
  horas = horas % 24; // se divide entre horas al día y te quedas con el resto
  dias = ((valMillis / 60) / 60) / 24; // Se convierte en días
#ifdef __DEBUG__
  Serial.print("Segundos = ");
  Serial.println(valMillis);
  Serial.print(dias);
  Serial.print(":");
  Serial.print(horas);
  Serial.print(":");
  Serial.print(minutos);
  Serial.print(":");
  Serial.println(segundos);
#endif
}
 

static const unsigned char PROGMEM datos_imagen[276] = {
    0x00, 0x00, 0x00, 0x02, 0x50, 0x00, 
    0x00, 0x00, 0x00, 0xbd, 0xa8, 0x00, 
    0x00, 0x00, 0x03, 0x56, 0xf0, 0x00, 
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    0x00, 0x00, 0x00, 0x00, 0x00, 0x00};

    int pulsador=0;

void setup() {
#ifdef __DEBUG__
  Serial.begin(9600);
  delay(100);
  Serial.println("Iniciando pantalla OLED");
#endif

  // Iniciar pantalla OLED en la dirección 0x3C
  if (!display.begin(SSD1306_SWITCHCAPVCC, 0x3C)) {
#ifdef __DEBUG__
    Serial.println("No se encuentra la pantalla OLED");
#endif
 pinMode(4, INPUT);           //declaramos el pin 4 como entrada
// pinMode(2, OUTPUT);
  }

  // Clear the buffer.
  display.clearDisplay();
  
  // Draw bitmap on the screen
  display.drawBitmap(40, 0, datos_imagen, 48, 46, SSD1306_WHITE);
  display.display();


}

void loop() {

      pulsador=digitalRead(4);
    if(pulsador==HIGH) {          //si el estado es pulsado
    
    pulsos=pulsos+1;
      //digitalWrite(2, HIGH);       //se enciende el led
      delay(100);
  }
//  else{                                   //si el estado es no pulsado
//    digitalWrite(2, LOW);       //se apaga el led
//  }

  // Protección overflow
  if (millis() < marcaTiempoDate) {
    marcaTiempoDate = millis();
  }

  // Comprobar is hay que actualizar tiempo
  if (millis() - marcaTiempoDate >= tiempoRefreshDate)
  {
    // Actualizar variables de tiempo
    millisToTiempo(millis());
    
    // Componer cadena con la información del tiempo formateada
    sprintf(cadenaTiempo, "%02d:%02d:%02d:%02d", dias, horas+pulsos, minutos, segundos);
    // Marca de tiempo
    marcaTiempoDate = millis();
  }
  
  // Limpiar texto tiempo
  display.fillRect(30,50,65,57,SSD1306_BLACK);
  // Dibujar texto tiempo
  display.setTextSize(1);
  display.setTextColor(SSD1306_WHITE);  
  display.setCursor(30, 50);
  display.println(cadenaTiempo);
 
  // Enviar a pantalla
  display.display();
  
  }
